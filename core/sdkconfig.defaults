## core/sdkconfig.defaults
```kconfig
# Performance

CONFIG_FREERTOS_HZ=1000

# Log timestamp: system time (HH:MM:SS.mmm) instead of boot milliseconds
CONFIG_LOG_TIMESTAMP_SOURCE_SYSTEM=y
CONFIG_OPTIMIZATION_LEVEL_RELEASE=y

CONFIG_ESP_DEFAULT_CPU_FREQ_MHZ_240=y
CONFIG_ESP_DEFAULT_CPU_FREQ_MHZ=240

# for DRAM overflow issue
CONFIG_ESP_WIFI_ENABLED=n

# Bluetooth Configuration - Disabled for APU-only build
CONFIG_BT_ENABLED=n

# SPI-RAM disabled. We do not allocate PSRAM anywhere in the Narya port
# (ROMs come from flash via esp_partition_mmap, the menu framebuffer and
# Anemoia mapper state live in internal DRAM). Keeping PSRAM enabled
# halves the available data cache for flash XIP, which slows the 6502
# interpreter to ~18 fps - Anemoia's published benchmarks assume no
# PSRAM. Switch off here to give the cache fully to flash.
CONFIG_SPIRAM=n

# Flash
CONFIG_ESPTOOLPY_FLASHMODE="qio"
CONFIG_ESPTOOLPY_FLASHMODE_QIO=y
CONFIG_ESPTOOLPY_FLASHFREQ="80m"
CONFIG_ESPTOOLPY_FLASHFREQ_80M=y
CONFIG_ESPTOOLPY_FLASHSIZE="8MB"
CONFIG_ESPTOOLPY_FLASHSIZE_8MB=y

CONFIG_ESP_MAIN_TASK_AFFINITY_CPU0=y

CONFIG_PM_ENABLE=n

# Performance optimizations (Arduino-compatible)
CONFIG_COMPILER_OPTIMIZATION_PERF=y
CONFIG_COMPILER_OPTIMIZATION_ASSERTIONS_DISABLE=y

# Partion / VFS
CONFIG_PARTITION_TABLE_CUSTOM=y
CONFIG_VFS_SUPPORT_IO=y
CONFIG_SPIFFS_MAX_PARTITIONS=3

# Log level
CONFIG_LOG_DEFAULT_LEVEL_INFO=y
CONFIG_LOG_DEFAULT_LEVEL=3

# Arduino-compatible performance settings
# FreeRTOS optimizations matching Arduino
CONFIG_FREERTOS_IDLE_TASK_STACKSIZE=1024
CONFIG_FREERTOS_WATCHPOINT_END_OF_STACK=y
CONFIG_FREERTOS_USE_TICKLESS_IDLE=n

# Task watchdog - log only (no panic/reboot) so a stuck emulator does not
# yank the firmware out from under the user; manual recovery via the
# Select+R2 hid combo is the intended escape hatch.
CONFIG_ESP_TASK_WDT_PANIC=n
CONFIG_ESP_TASK_WDT_TIMEOUT_S=15

# SPI driver optimizations for real-time performance
CONFIG_SPI_MASTER_ISR_IN_IRAM=y
CONFIG_SPI_SLAVE_ISR_IN_IRAM=y
```
